## Phần cứng/station/main/Kconfig.projbuild
```kconfig
menu "Example Configuration"

    config ESP_WIFI_SSID
        string "WiFi SSID"
        default "myssid"
        help
            SSID (network name) for the example to connect to.

    config ESP_WIFI_PASSWORD
        string "WiFi Password"
        default "mypassword"
        help
            WiFi password (WPA or WPA2) for the example to use.

    config ESP_MAXIMUM_RETRY
        int "Maximum retry"
        default 5
        help
            Set the Maximum retry to avoid station reconnecting to the AP unlimited when the AP is really inexistent.

    config THINGSPEAK_WRITE_API_KEY
        string "ThindSpeak write API key"
	    default "1234567890123456"
	    help
		    API key obtained from 'https://thingspeak.com/' site.
		
		    You need to set up a free account on this site first.
endmenu
```
